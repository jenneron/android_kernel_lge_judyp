
qcom,LGE_BLT32_Tocad_3400mah {
	qcom, = <24>;
	/* #2991245_LGE_BLT32_3400mAh_averaged_MasterSlave_Jun22nd2017*/
	qcom,max-voltage-uv = <4400000>;
	qcom,fg-cc-cv-threshold-mv = <4390>;
	qcom,fastchg-current-ma = <3400>;
	qcom,nom-batt-capacity-mah = <3400>;
	qcom,batt-id-kohm = <56>;
	qcom,battery-beta = <4150>;
	qcom,battery-type = "LGE_BLT32_Tocad_3400mah";
	qcom,checksum = <0x218F>;
	qcom,gui-version = "PMI8998GUI - 2.0.0.58";
	qcom,fg-profile-data = [
		 54 1F D0 05
		 5B 0A 5F 06
		 77 1D 40 07
		 53 12 11 14
		 9A 18 F1 22
		 93 45 BA 52
		 55 00 00 00
		 0E 00 00 00
		 00 00 1C C5
		 D7 CD AD CA
		 1C 00 08 00
		 10 DB 6F E4
		 65 06 27 F3
		 0E F3 24 13
		 EC 06 1D 33
		 1C 06 09 20
		 27 00 14 00
		 01 20 4F 05
		 A4 0A 2B 06
		 0B 1D E3 FB
		 CD 04 A7 FB
		 67 19 95 22
		 E0 45 5A 52
		 5D 00 00 00
		 0C 00 00 00
		 00 00 FC D5
		 62 C2 96 B3
		 17 00 00 00
		 CE EA 6F E4
		 BF 06 86 00
		 7C E3 DD 0A
		 57 07 51 1A
		 9E 33 CC FF
		 07 10 00 00
		 B9 0D 66 46
		 17 00 40 00
		 11 02 0A FA
		 FF 00 00 00
		 00 00 00 00
		 00 00 00 00
		 00 00 00 00
		 00 00 00 00
		 00 00 00 00
		 00 00 00 00
		 00 00 00 00
		 00 00 00 00
		 00 00 00 00
		 00 00 00 00
		 00 00 00 00
		 00 00 00 00
		 00 00 00 00
		 00 00 00 00
		 00 00 00 00
		 00 00 00 00
		 00 00 00 00
		 00 00 00 00
	];
};
