
qcom,LGE_BLT32_LGC_3400mah {
	qcom, = <24>;
	/* #2991240_LGE_BLT32_3400mAh_averaged_MasterSlave_Jun26th2017*/
	qcom,max-voltage-uv = <4400000>;
	qcom,fg-cc-cv-threshold-mv = <4390>;
	qcom,fastchg-current-ma = <3400>;
	qcom,nom-batt-capacity-mah = <3400>;
	qcom,batt-id-kohm = <20>;
	qcom,battery-beta = <4150>;
	qcom,battery-type = "LGE_BLT32_LGC_3400mah";
	qcom,checksum = <0x1F4B>;
	qcom,gui-version = "PMI8998GUI - 2.0.0.58";
	qcom,fg-profile-data = [
		 8B 1F 96 05
		 73 0A 5B 06
		 4C 1D A8 D2
		 8C 0A B5 15
		 28 19 2D 22
		 11 3D A8 4A
		 5A 00 00 00
		 11 00 00 00
		 00 00 E4 CD
		 67 CD C7 CB
		 24 00 08 00
		 08 E2 BA 07
		 0D FD 01 F2
		 AC EB D7 0B
		 C6 F2 C8 3A
		 1B 06 09 20
		 27 00 14 00
		 B5 1F BE 05
		 2F 0A 7B FD
		 7A 1D 8B E5
		 EF 0B 0F 14
		 03 19 14 23
		 3F 45 55 53
		 52 00 00 00
		 0D 00 00 00
		 00 00 DE CC
		 82 C3 D0 CD
		 20 00 00 00
		 5E EB BA 07
		 7F FD A9 EA
		 0D EB 92 0A
		 14 02 9E 1A
		 B0 33 CC FF
		 07 10 00 00
		 AB 0D 66 46
		 20 00 40 00
		 99 01 0A FA
		 FF 00 00 00
		 00 00 00 00
		 00 00 00 00
		 00 00 00 00
		 00 00 00 00
		 00 00 00 00
		 00 00 00 00
		 00 00 00 00
		 00 00 00 00
		 00 00 00 00
		 00 00 00 00
		 00 00 00 00
		 00 00 00 00
		 00 00 00 00
		 00 00 00 00
		 00 00 00 00
		 00 00 00 00
		 00 00 00 00
		 00 00 00 00
	];
};
