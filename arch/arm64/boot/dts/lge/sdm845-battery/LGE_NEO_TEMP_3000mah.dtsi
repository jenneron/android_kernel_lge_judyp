
qcom,LGE_NEO_TEMP_3000mah {
	qcom, = <24>;
	/* #3093309_LGE_JudyU_BLT37_3000mAh_averaged_MasterSlave_Sept18th2017*/
	qcom,max-voltage-uv = <4400000>;
	qcom,fg-cc-cv-threshold-mv = <4390>;
	qcom,fastchg-current-ma = <3000>;
	qcom,nom-batt-capacity-mah = <3000>;
	qcom,batt-id-kohm = <120>;
	qcom,battery-beta = <4150>;
	qcom,battery-type = "LGE_NEO_TEMP_3000mah";
	qcom,checksum = <0x6F3D>;
	qcom,gui-version = "PMI8998GUI - 2.0.0.58";
	qcom,fg-profile-data = [
		 FD 1F 22 05
		 CE 0A 05 06
		 0F 1D 67 FA
		 5A F4 7F EA
		 59 17 C8 23
		 D6 44 95 53
		 66 00 00 00
		 0E 00 00 00
		 00 00 9F B4
		 26 CC EB C3
		 23 00 08 00
		 7B E2 C2 ED
		 20 06 A5 F3
		 0E 05 69 12
		 F2 EC 09 2A
		 1E 06 09 20
		 27 00 14 00
		 96 1B 99 FB
		 77 07 67 F2
		 E4 1C 76 02
		 39 0D A8 0A
		 90 10 08 32
		 9F 4C C4 5B
		 7D 00 00 00
		 0E 00 00 00
		 00 00 62 D5
		 02 00 77 D2
		 1B 00 00 00
		 68 00 C2 ED
		 9A 06 8E 00
		 E3 FD F7 03
		 4D F5 47 1A
		 99 33 CC FF
		 07 10 00 00
		 AA 0B 66 46
		 1B 00 40 00
		 FE 01 0A FA
		 FF 00 00 00
		 00 00 00 00
		 00 00 00 00
		 00 00 00 00
		 00 00 00 00
		 00 00 00 00
		 00 00 00 00
		 00 00 00 00
		 00 00 00 00
		 00 00 00 00
		 00 00 00 00
		 00 00 00 00
		 00 00 00 00
		 00 00 00 00
		 00 00 00 00
		 00 00 00 00
		 00 00 00 00
		 00 00 00 00
		 00 00 00 00
	];
};
