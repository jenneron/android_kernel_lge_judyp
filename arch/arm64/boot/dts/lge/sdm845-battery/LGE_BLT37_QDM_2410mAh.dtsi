
qcom,3205037_lge_blt37qdm_2410mah_averaged_masterslave_nov28th2017 {
	qcom, = <24>;
	/* #3205037_LGE_BLT37qdm_2410mAh_averaged_MasterSlave_Nov28th2017*/
	qcom,max-voltage-uv = <4350000>;
	qcom,fg-cc-cv-threshold-mv = <4340>;
	qcom,fastchg-current-ma = <2400>;
	qcom,nom-batt-capacity-mah = <2410>;
	qcom,batt-id-kohm = <9>;
	qcom,battery-beta = <4250>;
	qcom,battery-type = "LGE_BLT37_QDM_2410mah";
	qcom,checksum = <0x37B5>;
	qcom,gui-version = "PMI8998GUI - 2.0.0.58";
	qcom,fg-profile-data = [
		 8E 1F 9E 05
		 6B 0A 4B 06
		 4D 1D 37 CA
		 8C 0A C7 15
		 AB 18 DE 22
		 A7 45 A2 52
		 5A 00 00 00
		 0E 00 00 00
		 00 00 43 C5
		 2C CD 44 CB
		 23 00 08 00
		 D4 E3 9C EC
		 45 06 49 F3
		 B7 ED E6 12
		 EE EC 2D 33
		 1F 06 09 20
		 27 00 14 00
		 90 1F EC 05
		 17 0A AD 06
		 6D 1D 03 DB
		 41 0B 9F 14
		 4A 19 C0 22
		 A3 45 BE 52
		 54 00 00 00
		 0E 00 00 00
		 00 00 A9 CC
		 20 C2 00 AC
		 20 00 00 00
		 71 F2 9C EC
		 33 FD 36 F2
		 53 06 27 FA
		 D9 EB E3 1B
		 C0 33 CC FF
		 07 10 00 00
		 B2 09 99 45
		 20 00 40 00
		 AD 01 0A FA
		 FF 00 00 00
		 00 00 00 00
		 00 00 00 00
		 00 00 00 00
		 00 00 00 00
		 00 00 00 00
		 00 00 00 00
		 00 00 00 00
		 00 00 00 00
		 00 00 00 00
		 00 00 00 00
		 00 00 00 00
		 00 00 00 00
		 00 00 00 00
		 00 00 00 00
		 00 00 00 00
		 00 00 00 00
		 00 00 00 00
		 00 00 00 00
	];
};

